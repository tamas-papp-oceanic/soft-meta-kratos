## conf/layer.conf
```bitbake
HOSTTOOLS += "jq"

# We have a conf and classes directory, add to BBPATH
BBPATH .= ":${LAYERDIR}"

# We have recipes-* directories, add to BBFILES
BBFILES += "${LAYERDIR}/recipes-*/*/*.bb \
            ${LAYERDIR}/recipes-*/*/*.bbappend"

BBFILE_COLLECTIONS += "kratos"
BBFILE_PATTERN_kratos = "^${LAYERDIR}/"
BBFILE_PRIORITY_kratos = "6"

LAYERDEPENDS_kratos = "core"
LAYERSERIES_COMPAT_kratos = "scarthgap"
```
